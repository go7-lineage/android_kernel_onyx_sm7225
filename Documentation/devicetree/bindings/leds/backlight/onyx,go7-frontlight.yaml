## Documentation/devicetree/bindings/leds/backlight/onyx,go7-frontlight.yaml
```yaml
# SPDX-License-Identifier: (GPL-2.0-only OR BSD-2-Clause)
%YAML 1.2
---
$id: http://devicetree.org/schemas/leds/backlight/onyx,go7-frontlight.yaml#
$schema: http://devicetree.org/meta-schemas/core.yaml#

title: Onyx Boox Go 7 frontlight

maintainers:
  - ui-1 <134524800+ui-1@users.noreply.github.com>

description:
  TI LM3630A with the white LEDs on bank A and warm LEDs on bank B

properties:
  compatible:
    const: onyx,go7-frontlight

  reg:
    maxItems: 1

  enable-gpios:
    description: HWEN pin of the LM3630A.
    maxItems: 1

  vdd-supply:
    description: Supply of the LM3630A and its boost converter.

  vddio-supply:
    description: Supply of the I2C bus pull-ups.

required:
  - compatible
  - reg
  - enable-gpios
  - vdd-supply
  - vddio-supply

additionalProperties: false

examples:
  - |
    #include <dt-bindings/gpio/gpio.h>
    i2c {
        #address-cells = <1>;
        #size-cells = <0>;

        led-controller@38 {
            compatible = "onyx,go7-frontlight";
            reg = <0x38>;
            enable-gpios = <&tlmm 73 GPIO_ACTIVE_HIGH>;
            vdd-supply = <&vreg_vsys>;
            vddio-supply = <&vreg_l5a>;
        };
    };
```

## Documentation/devicetree/bindings/power/supply/qcom,pm6150-qg.yaml
```yaml
# SPDX-License-Identifier: (GPL-2.0-only OR BSD-2-Clause)
%YAML 1.2
---
$id: http://devicetree.org/schemas/power/supply/qcom,pm6150-qg.yaml#
$schema: http://devicetree.org/meta-schemas/core.yaml#

title: Qualcomm PM6150/PM7250B QGauge fuel gauge

maintainers:
  - ui-1 <134524800+ui-1@users.noreply.github.com>

description:
  The QGauge block of the PM6150 and PM7250B PMICs measures battery voltage and current.
  Driver reports them with battery temperature from a thermistor ADC channel and the battery
  data from monitored-battery. Some of its state lives in SDAM region. With the interrupts and
  the battery profile the driver estimates the state of charge from the gauge's samples

allOf:
  - $ref: power-supply.yaml#

properties:
  compatible:
    oneOf:
      - const: qcom,pm6150-qg
      - items:
          - const: qcom,pm7250b-qg
          - const: qcom,pm6150-qg

  reg:
    maxItems: 1

  interrupts:
    items:
      - description: battery voltage below the empty threshold
      - description: sample FIFO filled
      - description: open-circuit voltage measured in the low-current sleep state

  interrupt-names:
    items:
      - const: vbat-empty
      - const: fifo-done
      - const: good-ocv

  io-channels:
    items:
      - description: battery thermistor (temperature in millidegrees Celsius)
      - description: battery ID resistor

  io-channel-names:
    items:
      - const: batt-therm
      - const: batt-id

  nvmem:
    maxItems: 1
    description: SDAM region holding QGauge state

  monitored-battery: true

  battery-profile:
    type: object
    additionalProperties: false
    description:
      Characterisation of the battery by the PMIC vendor. Tables over temperature, and over
      state of charge and temperature, with the values in the vendor's encoding.

    patternProperties:
      "^qcom,fcc[12]-temp-lut$":
        type: object
        additionalProperties: false
        description: Full charge capacity in mAh while charging (1) and discharging (2).

        properties:
          qcom,lut-col-legend:
            $ref: /schemas/types.yaml#/definitions/int32-array
            description: Temperatures in degrees Celsius, ascending.
            minItems: 1
            maxItems: 16

          qcom,lut-data:
            $ref: /schemas/types.yaml#/definitions/uint32-matrix
            description: One value per temperature.
            maxItems: 1
            items:
              minItems: 1
              maxItems: 16

        required:
          - qcom,lut-col-legend
          - qcom,lut-data

      "^qcom,pc-temp-(v[12]|[yz][1-6])-lut$":
        type: object
        additionalProperties: false
        description:
          Open-circuit voltage in units of 100 uV while charging (v1) and discharging (v2),
          and encoded impedance parameters while charging (z1 to z6) and discharging (y1 to y6).

        properties:
          qcom,lut-col-legend:
            $ref: /schemas/types.yaml#/definitions/int32-array
            description: Temperatures in degrees Celsius, ascending.
            minItems: 1
            maxItems: 16

          qcom,lut-row-legend:
            $ref: /schemas/types.yaml#/definitions/uint32-array
            description: States of charge in units of 0.01 percent, descending.
            minItems: 2
            maxItems: 128

          qcom,lut-data:
            $ref: /schemas/types.yaml#/definitions/uint32-matrix
            description: One row per state of charge, one value per temperature.
            minItems: 2
            maxItems: 128
            items:
              minItems: 1
              maxItems: 16

        required:
          - qcom,lut-col-legend
          - qcom,lut-row-legend
          - qcom,lut-data

required:
  - compatible
  - reg
  - io-channels
  - io-channel-names
  - nvmem
  - monitored-battery

unevaluatedProperties: false

examples:
  - |
    #include <dt-bindings/iio/qcom,spmi-vadc.h>

    pmic {
        #address-cells = <1>;
        #size-cells = <0>;

        battery@4800 {
            compatible = "qcom,pm7250b-qg", "qcom,pm6150-qg";
            reg = <0x4800>;
            io-channels = <&bat_therm_sensor>,
                          <&pm7250b_adc ADC5_BAT_ID_100K_PU>;
            io-channel-names = "batt-therm",
                               "batt-id";
            nvmem = <&pm7250b_qg_sdam>;
            monitored-battery = <&battery>;
        };
    };
```

## Documentation/devicetree/bindings/power/supply/qcom,pmi8998-charger.yaml
```yaml
# SPDX-License-Identifier: GPL-2.0 OR BSD-2-Clause
%YAML 1.2
---
$id: http://devicetree.org/schemas/power/supply/qcom,pmi8998-charger.yaml#
$schema: http://devicetree.org/meta-schemas/core.yaml#

title: Qualcomm PMI8998/PM660 Switch-Mode Battery Charger "2"

maintainers:
  - Casey Connolly <casey.connolly@linaro.org>

properties:
  compatible:
    enum:
      - qcom,pm7250b-charger
      - qcom,pm8150b-charger
      - qcom,pmi8998-charger
      - qcom,pm660-charger

  reg:
    maxItems: 1

  interrupts:
    maxItems: 4

  interrupt-names:
    items:
      - const: usb-plugin
      - const: bat-ov
      - const: wdog-bark
      - const: usbin-icl-change

  io-channels:
    items:
      - description: USB in current in uA
      - description: USB in voltage in uV

  io-channel-names:
    items:
      - const: usbin_i
      - const: usbin_v

  monitored-battery: true

  qcom,jeita-soft-thresholds:
    $ref: /schemas/types.yaml#/definitions/uint32-array
    description:
      Battery thermistor readings, as codes of the charger's ADC, of the cool and the warm soft JEITA
      threshold. Below the cool and above the warm threshold the charger applies the first and the second
      value of qcom,jeita-soft-fcc-microamp and qcom,jeita-soft-fv-microvolt.
    minItems: 2
    maxItems: 2
    items:
      maximum: 0xffff

  qcom,jeita-soft-fcc-microamp:
    description: Fast charge current below the cool and above the warm threshold.
    minItems: 2
    maxItems: 2

  qcom,jeita-soft-fv-microvolt:
    description:
      Float voltage below the cool and above the warm threshold. The first value must equal the float
      voltage outside the soft zones.
    minItems: 2
    maxItems: 2

required:
  - compatible
  - reg
  - interrupts
  - interrupt-names
  - io-channels
  - io-channel-names
  - monitored-battery

dependentRequired:
  qcom,jeita-soft-thresholds: [ 'qcom,jeita-soft-fcc-microamp', 'qcom,jeita-soft-fv-microvolt' ]
  qcom,jeita-soft-fcc-microamp: [ 'qcom,jeita-soft-thresholds' ]
  qcom,jeita-soft-fv-microvolt: [ 'qcom,jeita-soft-thresholds' ]

allOf:
  - $ref: power-supply.yaml#

additionalProperties: false

examples:
  - |
    #include <dt-bindings/interrupt-controller/irq.h>

    pmic {
      #address-cells = <1>;
      #size-cells = <0>;

      charger@1000 {
        compatible = "qcom,pmi8998-charger";
        reg = <0x1000>;

        interrupts = <0x2 0x12 0x2 IRQ_TYPE_EDGE_BOTH>,
                     <0x2 0x13 0x4 IRQ_TYPE_EDGE_BOTH>,
                     <0x2 0x13 0x6 IRQ_TYPE_EDGE_RISING>,
                     <0x2 0x16 0x1 IRQ_TYPE_EDGE_RISING>;
        interrupt-names = "usb-plugin", "bat-ov", "wdog-bark", "usbin-icl-change";

        io-channels = <&pmi8998_rradc 3>,
                      <&pmi8998_rradc 4>;
        io-channel-names = "usbin_i",
                           "usbin_v";

        monitored-battery = <&battery>;
      };
    };
  - |
    #include <dt-bindings/interrupt-controller/irq.h>

    pmic {
      #address-cells = <1>;
      #size-cells = <0>;

      charger@1000 {
        compatible = "qcom,pm7250b-charger";
        reg = <0x1000>;

        interrupts = <0x2 0x13 0x4 IRQ_TYPE_EDGE_BOTH>,
                     <0x2 0x12 0x2 IRQ_TYPE_EDGE_BOTH>,
                     <0x2 0x16 0x1 IRQ_TYPE_EDGE_RISING>,
                     <0x2 0x13 0x7 IRQ_TYPE_EDGE_RISING>;
        interrupt-names = "usb-plugin", "bat-ov", "wdog-bark", "usbin-icl-change";

        io-channels = <&pm7250b_adc 7>,
                      <&pm7250b_adc 8>;
        io-channel-names = "usbin_i",
                           "usbin_v";

        monitored-battery = <&battery>;
        qcom,jeita-soft-thresholds = <0x3f46 0x20b8>;
        qcom,jeita-soft-fcc-microamp = <450000 1000000>;
        qcom,jeita-soft-fv-microvolt = <4400000 4100000>;
      };
    };
```
