## Documentation/devicetree/bindings/display/onyx,go7-epd.yaml
```yaml
# SPDX-License-Identifier: (GPL-2.0-only OR BSD-2-Clause)
%YAML 1.2
---
$id: http://devicetree.org/schemas/display/onyx,go7-epd.yaml#
$schema: http://devicetree.org/meta-schemas/core.yaml#

title: Onyx Boox Go 7 e-ink display controller

maintainers:
  - ui-1 <134524800+ui-1@users.noreply.github.com>

description:
  Virtual display device for Go 7's e-ink panel.

properties:
  compatible:
    const: onyx,go7-epd

  onyx,dsi:
    $ref: /schemas/types.yaml#/definitions/phandle
    description: DSI host the onyx,go7-eink-dsi panel is attached to.

  onyx,tcon:
    $ref: /schemas/types.yaml#/definitions/phandle
    description: TCON that has to be running before frames are sent.

  display-supply:
    description: Panel source/gate driver rails (VPOS/VNEG, VGH/VGL).

  vcom-supply:
    description: Panel VCOM set from bootloader's fp9931:vcom= argument.

  v3p3-supply:
    description: 3.3 V panel logic rail.

required:
  - compatible
  - onyx,dsi
  - display-supply
  - vcom-supply

additionalProperties: false

examples:
  - |
    epd {
        compatible = "onyx,go7-epd";
        onyx,dsi = <&mdss_dsi0>;
        onyx,tcon = <&tcon>;
        display-supply = <&epd_vposneg>;
        vcom-supply = <&epd_vcom>;
        v3p3-supply = <&epd_v3p3>;
    };
...
```

## Documentation/devicetree/bindings/display/panel/onyx,go7-eink-dsi.yaml
```yaml
# SPDX-License-Identifier: (GPL-2.0-only OR BSD-2-Clause)
%YAML 1.2
---
$id: http://devicetree.org/schemas/display/panel/onyx,go7-eink-dsi.yaml#
$schema: http://devicetree.org/meta-schemas/core.yaml#

title: Onyx Boox Go 7 e-ink panel DSI link

maintainers:
  - ui-1 <134524800+ui-1@users.noreply.github.com>

description:
  MIPI DSI command-mode link from SoC to e-ink TCON.

allOf:
  - $ref: panel-common.yaml#

properties:
  compatible:
    const: onyx,go7-eink-dsi

  reg:
    maxItems: 1

  reset-gpios: true
  port: true

required:
  - compatible
  - reg
  - port

additionalProperties: false

examples:
  - |
    #include <dt-bindings/gpio/gpio.h>

    dsi {
        #address-cells = <1>;
        #size-cells = <0>;

        panel@0 {
            compatible = "onyx,go7-eink-dsi";
            reg = <0>;
            reset-gpios = <&tlmm 51 GPIO_ACTIVE_LOW>;

            port {
                panel_in: endpoint {
                    remote-endpoint = <&dsi0_out>;
                };
            };
        };
    };
...
```

## Documentation/devicetree/bindings/input/onyx,go7-hall.yaml
```yaml
# SPDX-License-Identifier: (GPL-2.0-only OR BSD-2-Clause)
%YAML 1.2
---
$id: http://devicetree.org/schemas/input/onyx,go7-hall.yaml#
$schema: http://devicetree.org/meta-schemas/core.yaml#

title: Onyx Boox Go 7 cover sensor

maintainers:
  - ui-1 <134524800+ui-1@users.noreply.github.com>

description:
  Sensor for the folio cover. Closing the cover reports KEY_POWER, opening it reports KEY_WAKEUP.

properties:
  compatible:
    const: onyx,go7-hall

  irq-gpios:
    description: Sensor output; low = cover closed.
    maxItems: 1

  vdd-supply: true

  onyx,send-alt-key:
    type: boolean
    description: Wrap each key in KEY_LEFTALT down/up.

required:
  - compatible
  - irq-gpios

additionalProperties: false

examples:
  - |
    #include <dt-bindings/gpio/gpio.h>
    hall-sensor {
        compatible = "onyx,go7-hall";
        irq-gpios = <&tlmm 99 GPIO_ACTIVE_HIGH>;
    };
```

## Documentation/devicetree/bindings/input/touchscreen/istaric,is5662.yaml
```yaml
# SPDX-License-Identifier: (GPL-2.0-only OR BSD-2-Clause)
%YAML 1.2
---
$id: http://devicetree.org/schemas/input/touchscreen/istaric,is5662.yaml#
$schema: http://devicetree.org/meta-schemas/core.yaml#

title: Istaric IS5662 capacitive touchscreen controller

maintainers:
  - ui-1 <134524800+ui-1@users.noreply.github.com>

allOf:
  - $ref: touchscreen.yaml#

properties:
  compatible:
    const: istaric,is5662

  reg:
    maxItems: 1

  interrupts:
    maxItems: 1

  reset-gpios:
    maxItems: 1

  vdd-supply: true
  vcc-supply: true

  vdd-enable-gpios:
    description: Board switch in front of the VDD (logic) supply.
    maxItems: 1

  vcc-enable-gpios:
    description: Board switch in front of the VCC (sensor) supply.
    maxItems: 1

required:
  - compatible
  - reg
  - interrupts
  - reset-gpios

unevaluatedProperties: false

examples:
  - |
    #include <dt-bindings/gpio/gpio.h>
    #include <dt-bindings/interrupt-controller/irq.h>
    i2c {
        #address-cells = <1>;
        #size-cells = <0>;

        touchscreen@55 {
            compatible = "istaric,is5662";
            reg = <0x55>;
            interrupts-extended = <&tlmm 22 IRQ_TYPE_LEVEL_LOW>;
            reset-gpios = <&tlmm 21 GPIO_ACTIVE_LOW>;
            touchscreen-size-x = <1264>;
            touchscreen-size-y = <1680>;
        };
    };
```

## Documentation/devicetree/bindings/misc/onyx,go7-mxo1300.yaml
```yaml
# SPDX-License-Identifier: (GPL-2.0-only OR BSD-2-Clause)
%YAML 1.2
---
$id: http://devicetree.org/schemas/misc/onyx,go7-mxo1300.yaml#
$schema: http://devicetree.org/meta-schemas/core.yaml#

title: Onyx Boox Go 7 e-ink TCON

maintainers:
  - ui-1 <134524800+ui-1@users.noreply.github.com>

description:
  FPGA between SoC's DSI output and the e-ink panel's source drivers.

properties:
  compatible:
    const: onyx,go7-mxo1300

  reg:
    maxItems: 1

  reset-gpios:
    maxItems: 1

  done-gpios:
    description: Configuration DONE output of the FPGA (input only).
    maxItems: 1

  vsys-supply: true
  vdd1v8-supply: true
  vdd3v-supply: true
  vdd1v2-supply: true

required:
  - compatible
  - reg
  - reset-gpios
  - vdd1v8-supply
  - vdd3v-supply
  - vdd1v2-supply

additionalProperties: false

examples:
  - |
    #include <dt-bindings/gpio/gpio.h>
    i2c {
        #address-cells = <1>;
        #size-cells = <0>;

        tcon@40 {
            compatible = "onyx,go7-mxo1300";
            reg = <0x40>;
            reset-gpios = <&tlmm 12 GPIO_ACTIVE_LOW>;
            vdd1v8-supply = <&vreg_1v8>;
            vdd3v-supply = <&vreg_3v>;
            vdd1v2-supply = <&vreg_1v2>;
        };
    };
```

## Documentation/devicetree/bindings/power/supply/qcom,pm6150-qg.yaml
```yaml
# SPDX-License-Identifier: (GPL-2.0-only OR BSD-2-Clause)
%YAML 1.2
---
$id: http://devicetree.org/schemas/power/supply/qcom,pm6150-qg.yaml#
$schema: http://devicetree.org/meta-schemas/core.yaml#

title: Qualcomm PM6150/PM7250B QGauge fuel gauge

maintainers:
  - ui-1 <134524800+ui-1@users.noreply.github.com>

description:
  The QGauge block of the PM6150 and PM7250B PMICs measures battery voltage and current.
  Driver reports them with battery temperature from a thermistor ADC channel and the battery
  data from monitored-battery. Some of its state lives in SDAM region

allOf:
  - $ref: power-supply.yaml#

properties:
  compatible:
    oneOf:
      - const: qcom,pm6150-qg
      - items:
          - const: qcom,pm7250b-qg
          - const: qcom,pm6150-qg

  reg:
    maxItems: 1

  io-channels:
    items:
      - description: battery thermistor (temperature in millidegrees Celsius)
      - description: battery ID resistor

  io-channel-names:
    items:
      - const: batt-therm
      - const: batt-id

  nvmem:
    maxItems: 1
    description: SDAM region holding QGauge state

  monitored-battery: true

required:
  - compatible
  - reg
  - io-channels
  - io-channel-names
  - nvmem
  - monitored-battery

unevaluatedProperties: false

examples:
  - |
    #include <dt-bindings/iio/qcom,spmi-vadc.h>

    pmic {
        #address-cells = <1>;
        #size-cells = <0>;

        battery@4800 {
            compatible = "qcom,pm7250b-qg", "qcom,pm6150-qg";
            reg = <0x4800>;
            io-channels = <&bat_therm_sensor>,
                          <&pm7250b_adc ADC5_BAT_ID_100K_PU>;
            io-channel-names = "batt-therm",
                               "batt-id";
            nvmem = <&pm7250b_qg_sdam>;
            monitored-battery = <&battery>;
        };
    };
```

## drivers/gpu/drm/onyx/Kconfig
```kconfig
# SPDX-License-Identifier: GPL-2.0-only
config DRM_ONYX_EPD
	tristate "Onyx Boox Go 7 e-ink display"
	depends on DRM && OF && ARM64 && KERNEL_MODE_NEON
	depends on DRM_MSM
	select DRM_CLIENT
	select DRM_KMS_HELPER
	select DRM_GEM_SHMEM_HELPER
	select FW_LOADER
	help
	  E-ink display of the Onyx Boox Go 7.
```
